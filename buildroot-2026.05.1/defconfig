## buildroot-2026.05.1/defconfig
```kconfig
BR2_x86_64=y
BR2_JLEVEL=20
BR2_ROOTFS_DEVICE_CREATION_DYNAMIC_EUDEV=y
BR2_SYSTEM_ENABLE_NLS=y
BR2_LINUX_KERNEL=y
BR2_LINUX_KERNEL_USE_ARCH_DEFAULT_CONFIG=y
BR2_LINUX_KERNEL_ZSTD=y
BR2_PACKAGE_PETITBOOT=y
BR2_TARGET_ROOTFS_INITRAMFS=y
# BR2_TARGET_ROOTFS_TAR is not set
```

## buildroot-2026.05.1/linux_defconfig
```kconfig
# CONFIG_LOCALVERSION_AUTO is not set
CONFIG_KERNEL_ZSTD=y
# CONFIG_CROSS_MEMORY_ATTACH is not set
CONFIG_NO_HZ_IDLE=y
CONFIG_HIGH_RES_TIMERS=y
# CONFIG_PREEMPT_DYNAMIC is not set
CONFIG_BLK_DEV_INITRD=y
CONFIG_INITRAMFS_SOURCE="initramfs.cpio"
CONFIG_INITRAMFS_COMPRESSION_NONE=y
CONFIG_CC_OPTIMIZE_FOR_SIZE=y
CONFIG_EXPERT=y
# CONFIG_MULTIUSER is not set
# CONFIG_SGETMASK_SYSCALL is not set
# CONFIG_FHANDLE is not set
# CONFIG_PCSPKR_PLATFORM is not set
# CONFIG_AIO is not set
# CONFIG_IO_URING is not set
# CONFIG_ADVISE_SYSCALLS is not set
# CONFIG_CACHESTAT_SYSCALL is not set
# CONFIG_KALLSYMS is not set
CONFIG_KEXEC=y
CONFIG_KEXEC_HANDOVER=y
# CONFIG_KEXEC_HANDOVER_DEBUGFS is not set
CONFIG_KEXEC_HANDOVER_ENABLE_DEFAULT=y
CONFIG_SMP=y
# CONFIG_X86_EXTENDED_PLATFORM is not set
CONFIG_NR_CPUS=4
# CONFIG_X86_MCE is not set
# CONFIG_PERF_EVENTS_AMD_UNCORE is not set
# CONFIG_X86_VSYSCALL_EMULATION is not set
# CONFIG_X86_IOPL_IOPERM is not set
# CONFIG_MTRR is not set
# CONFIG_X86_UMIP is not set
CONFIG_X86_INTEL_TSX_MODE_ON=y
# CONFIG_RANDOMIZE_BASE is not set
CONFIG_LEGACY_VSYSCALL_NONE=y
CONFIG_CMDLINE_BOOL=y
CONFIG_CMDLINE="console=ttyS0,115200 console=tty0"
# CONFIG_MODIFY_LDT_SYSCALL is not set
# CONFIG_X86_BUS_LOCK_DETECT is not set
# CONFIG_CPU_MITIGATIONS is not set
# CONFIG_SUSPEND is not set
# CONFIG_VIRTUALIZATION is not set
# CONFIG_SECCOMP is not set
# CONFIG_STACKPROTECTOR is not set
CONFIG_LTO_CLANG_FULL=y
# CONFIG_RANDOMIZE_KSTACK_OFFSET is not set
# CONFIG_COREDUMP is not set
CONFIG_SLUB_TINY=y
# CONFIG_COMPAT_BRK is not set
# CONFIG_ZONE_DMA is not set
# CONFIG_VM_EVENT_COUNTERS is not set
# CONFIG_SECRETMEM is not set
CONFIG_LRU_GEN=y
CONFIG_LRU_GEN_ENABLED=y
CONFIG_PCI=y
CONFIG_DEVTMPFS=y
CONFIG_DEVTMPFS_MOUNT=y
# CONFIG_FW_LOADER is not set
# CONFIG_ALLOW_DEV_COREDUMP is not set
CONFIG_SYSFB_SIMPLEFB=y
CONFIG_GOOGLE_FIRMWARE=y
CONFIG_GOOGLE_CBMEM=y
CONFIG_GOOGLE_COREBOOT_TABLE=y
CONFIG_GOOGLE_FRAMEBUFFER_COREBOOT=y
CONFIG_GOOGLE_MEMCONSOLE_COREBOOT=y
CONFIG_GOOGLE_VPD=y
CONFIG_BLK_DEV_NVME=y
CONFIG_NVME_MULTIPATH=y
# CONFIG_INTEL_MEI is not set
CONFIG_BLK_DEV_SD=y
CONFIG_SCSI_LOGGING=y
CONFIG_SCSI_SCAN_ASYNC=y
CONFIG_ATA=y
CONFIG_SATA_AHCI=y
# CONFIG_INPUT_MOUSE is not set
CONFIG_SERIAL_8250=y
CONFIG_SERIAL_8250_CONSOLE=y
CONFIG_TTY_PRINTK=y
# CONFIG_HW_RANDOM is not set
# CONFIG_DEVPORT is not set
# CONFIG_HWMON is not set
CONFIG_FB=y
CONFIG_FB_SIMPLE=y
CONFIG_FRAMEBUFFER_CONSOLE=y
CONFIG_FRAMEBUFFER_CONSOLE_DETECT_PRIMARY=y
CONFIG_USB_ULPI_BUS=y
CONFIG_USB=y
CONFIG_USB_XHCI_HCD=y
CONFIG_USB_EHCI_HCD=y
CONFIG_USB_STORAGE=y
CONFIG_TYPEC=y
CONFIG_TYPEC_TCPM=y
CONFIG_TYPEC_UCSI=y
CONFIG_UCSI_ACPI=y
CONFIG_TYPEC_TBT_ALTMODE=y
CONFIG_MMC=y
# CONFIG_VIRTIO_MENU is not set
# CONFIG_VHOST_MENU is not set
# CONFIG_SURFACE_PLATFORMS is not set
# CONFIG_X86_PLATFORM_DEVICES is not set
# CONFIG_IOMMU_SUPPORT is not set
CONFIG_MEMORY=y
CONFIG_EXT4_FS=y
# CONFIG_FILE_LOCKING is not set
# CONFIG_DNOTIFY is not set
# CONFIG_INOTIFY_USER is not set
CONFIG_VFAT_FS=y
CONFIG_FAT_DEFAULT_UTF8=y
CONFIG_EXFAT_FS=y
CONFIG_TMPFS=y
CONFIG_CONFIGFS_FS=y
# CONFIG_MISC_FILESYSTEMS is not set
CONFIG_NLS_CODEPAGE_437=y
CONFIG_NLS_ASCII=y
CONFIG_NLS_ISO8859_1=y
CONFIG_NLS_UTF8=y
# CONFIG_CRC_OPTIMIZATIONS is not set
# CONFIG_XZ_DEC_POWERPC is not set
# CONFIG_XZ_DEC_ARM is not set
# CONFIG_XZ_DEC_ARMTHUMB is not set
# CONFIG_XZ_DEC_ARM64 is not set
# CONFIG_XZ_DEC_SPARC is not set
# CONFIG_XZ_DEC_RISCV is not set
CONFIG_PRINTK_TIME=y
# CONFIG_SYMBOLIC_ERRNAME is not set
# CONFIG_DEBUG_MISC is not set
CONFIG_FRAME_WARN=1280
# CONFIG_SECTION_MISMATCH_WARN_ONLY is not set
# CONFIG_RCU_TRACE is not set
# CONFIG_FTRACE is not set
# CONFIG_X86_VERBOSE_BOOTUP is not set
# CONFIG_X86_DEBUG_FPU is not set
CONFIG_UNWINDER_GUESS=y
# CONFIG_RUNTIME_TESTING_MENU is not set
```

## configs/linux_defconfig
```kconfig
# CONFIG_LOCALVERSION_AUTO is not set
CONFIG_KERNEL_ZSTD=y
CONFIG_DEFAULT_HOSTNAME="linuxboot"
# CONFIG_CROSS_MEMORY_ATTACH is not set
CONFIG_NO_HZ_IDLE=y
CONFIG_HIGH_RES_TIMERS=y
# CONFIG_PREEMPT_DYNAMIC is not set
CONFIG_RELAY=y
CONFIG_BLK_DEV_INITRD=y
CONFIG_INITRAMFS_SOURCE="initramfs.cpio"
CONFIG_INITRAMFS_COMPRESSION_NONE=y
CONFIG_EXPERT=y
# CONFIG_SGETMASK_SYSCALL is not set
# CONFIG_FHANDLE is not set
# CONFIG_PCSPKR_PLATFORM is not set
# CONFIG_AIO is not set
# CONFIG_IO_URING is not set
# CONFIG_ADVISE_SYSCALLS is not set
# CONFIG_CACHESTAT_SYSCALL is not set
# CONFIG_KALLSYMS is not set
CONFIG_KEXEC=y
# CONFIG_CRASH_DUMP is not set
CONFIG_KEXEC_HANDOVER=y
# CONFIG_KEXEC_HANDOVER_DEBUGFS is not set
# CONFIG_X86_EXTENDED_PLATFORM is not set
# CONFIG_X86_MCE is not set
# CONFIG_PERF_EVENTS_INTEL_UNCORE is not set
# CONFIG_PERF_EVENTS_INTEL_RAPL is not set
# CONFIG_PERF_EVENTS_INTEL_CSTATE is not set
# CONFIG_PERF_EVENTS_AMD_UNCORE is not set
# CONFIG_X86_VSYSCALL_EMULATION is not set
# CONFIG_X86_IOPL_IOPERM is not set
# CONFIG_MTRR_SANITIZER is not set
# CONFIG_X86_UMIP is not set
CONFIG_X86_INTEL_TSX_MODE_ON=y
# CONFIG_RANDOMIZE_BASE is not set
CONFIG_LEGACY_VSYSCALL_NONE=y
# CONFIG_MODIFY_LDT_SYSCALL is not set
# CONFIG_X86_BUS_LOCK_DETECT is not set
# CONFIG_CPU_MITIGATIONS is not set
# CONFIG_SUSPEND is not set
CONFIG_ACPI_CONTAINER=y
# CONFIG_ISA_DMA_API is not set
# CONFIG_VIRTUALIZATION is not set
CONFIG_JUMP_LABEL=y
# CONFIG_SECCOMP is not set
# CONFIG_STACKPROTECTOR is not set
CONFIG_LTO_CLANG_FULL=y
# CONFIG_RANDOMIZE_KSTACK_OFFSET is not set
# CONFIG_MQ_IOSCHED_DEADLINE is not set
# CONFIG_MQ_IOSCHED_KYBER is not set
# CONFIG_IOSCHED_BFQ is not set
# CONFIG_COREDUMP is not set
CONFIG_SLUB_TINY=y
# CONFIG_COMPAT_BRK is not set
# CONFIG_ZONE_DMA is not set
# CONFIG_VM_EVENT_COUNTERS is not set
# CONFIG_SECRETMEM is not set
CONFIG_LRU_GEN=y
CONFIG_LRU_GEN_ENABLED=y
CONFIG_PCI=y
# CONFIG_PCIEPORTBUS is not set
# CONFIG_VGA_ARB is not set
# CONFIG_HOTPLUG_PCI is not set
CONFIG_DEVTMPFS=y
CONFIG_DEVTMPFS_MOUNT=y
# CONFIG_FW_LOADER is not set
# CONFIG_ALLOW_DEV_COREDUMP is not set
CONFIG_GOOGLE_FIRMWARE=y
CONFIG_GOOGLE_CBMEM=y
CONFIG_GOOGLE_COREBOOT_TABLE=y
CONFIG_GOOGLE_FRAMEBUFFER_COREBOOT=y
CONFIG_GOOGLE_MEMCONSOLE_COREBOOT=y
CONFIG_GOOGLE_VPD=y
# CONFIG_PNP_DEBUG_MESSAGES is not set
CONFIG_BLK_DEV_LOOP=y
CONFIG_BLK_DEV_RAM=y
CONFIG_BLK_DEV_NVME=y
CONFIG_NVME_MULTIPATH=y
# CONFIG_INTEL_MEI is not set
CONFIG_BLK_DEV_SD=y
# CONFIG_BLK_DEV_BSG is not set
CONFIG_SCSI_LOGGING=y
CONFIG_SCSI_SCAN_ASYNC=y
CONFIG_ATA=y
CONFIG_SATA_AHCI=y
# CONFIG_INPUT_MOUSE is not set
# CONFIG_LEGACY_TIOCSTI is not set
CONFIG_SERIAL_8250=y
CONFIG_SERIAL_8250_CONSOLE=y
CONFIG_TTY_PRINTK=y
# CONFIG_HW_RANDOM is not set
# CONFIG_DEVPORT is not set
# CONFIG_HWMON is not set
CONFIG_DRM=y
CONFIG_DRM_COREBOOTDRM=y
CONFIG_FB=y
# CONFIG_FB_DEVICE is not set
# CONFIG_VGA_CONSOLE is not set
CONFIG_USB_ULPI_BUS=y
CONFIG_USB=y
CONFIG_USB_XHCI_HCD=y
CONFIG_USB_EHCI_HCD=y
CONFIG_USB_STORAGE=y
CONFIG_TYPEC=y
CONFIG_TYPEC_TCPM=y
CONFIG_TYPEC_UCSI=y
CONFIG_UCSI_ACPI=y
CONFIG_TYPEC_TBT_ALTMODE=y
CONFIG_MMC=y
# CONFIG_VIRTIO_MENU is not set
# CONFIG_VHOST_MENU is not set
# CONFIG_SURFACE_PLATFORMS is not set
# CONFIG_X86_PLATFORM_DEVICES is not set
CONFIG_MAILBOX=y
CONFIG_PCC=y
# CONFIG_IOMMU_SUPPORT is not set
CONFIG_MEMORY=y
CONFIG_USB4=y
CONFIG_EXT4_FS=y
# CONFIG_FILE_LOCKING is not set
# CONFIG_DNOTIFY is not set
# CONFIG_INOTIFY_USER is not set
CONFIG_VFAT_FS=y
CONFIG_FAT_DEFAULT_UTF8=y
CONFIG_EXFAT_FS=y
CONFIG_TMPFS=y
CONFIG_CONFIGFS_FS=y
# CONFIG_MISC_FILESYSTEMS is not set
CONFIG_NLS_CODEPAGE_437=y
CONFIG_NLS_ASCII=y
CONFIG_NLS_ISO8859_1=y
CONFIG_NLS_UTF8=y
# CONFIG_CRC_OPTIMIZATIONS is not set
# CONFIG_XZ_DEC_POWERPC is not set
# CONFIG_XZ_DEC_ARM is not set
# CONFIG_XZ_DEC_ARMTHUMB is not set
# CONFIG_XZ_DEC_ARM64 is not set
# CONFIG_XZ_DEC_SPARC is not set
# CONFIG_XZ_DEC_RISCV is not set
CONFIG_PRINTK_TIME=y
# CONFIG_SYMBOLIC_ERRNAME is not set
# CONFIG_DEBUG_MISC is not set
CONFIG_FRAME_WARN=1280
# CONFIG_SECTION_MISMATCH_WARN_ONLY is not set
# CONFIG_FTRACE is not set
# CONFIG_X86_VERBOSE_BOOTUP is not set
# CONFIG_X86_DEBUG_FPU is not set
CONFIG_UNWINDER_GUESS=y
# CONFIG_RUNTIME_TESTING_MENU is not set
```

## configs/t480s_defconfig
```kconfig
CONFIG_LTO=y
CONFIG_COMPRESS_RAMSTAGE_ZSTD=y
CONFIG_VENDOR_LENOVO=y
CONFIG_LINEAR_FRAMEBUFFER_MAX_HEIGHT=1080
CONFIG_LINEAR_FRAMEBUFFER_MAX_WIDTH=1920
CONFIG_ONBOARD_VGA_IS_PRIMARY=y
CONFIG_IFD_BIN_PATH="bins/t480s/flashregion_0_flashdescriptor.bin"
CONFIG_ME_BIN_PATH="bins/t480s/flashregion_2_intel_me.bin"
CONFIG_GBE_BIN_PATH="bins/t480s/flashregion_3_gbe.bin"
CONFIG_EDK2_BOOT_TIMEOUT=0
CONFIG_INTEL_OC_MAILBOX_ENABLE_UNDERVOLTING=y
CONFIG_USE_LEGACY_8254_TIMER=y
CONFIG_HAVE_IFD_BIN=y
CONFIG_BOARD_LENOVO_T480S=y
# CONFIG_EDK2_FOLLOW_BGRT_SPEC is not set
CONFIG_H8_FN_CTRL_SWAP=y
CONFIG_HAVE_ME_BIN=y
CONFIG_HAVE_GBE_BIN=y
# CONFIG_ON_DEVICE_ROM_LOAD is not set
# CONFIG_DRIVERS_OPTION_CFR is not set
CONFIG_VBT_CBFS_COMPRESSION_NONE=y
CONFIG_DRIVERS_PS2_KEYBOARD=y
# CONFIG_TPM2 is not set
# CONFIG_BOOTBLOCK_CONSOLE is not set
# CONFIG_POSTCAR_CONSOLE is not set
# CONFIG_SQUELCH_EARLY_SMP is not set
# CONFIG_CONSOLE_CBMEM is not set
CONFIG_DEFAULT_CONSOLE_LOGLEVEL_3=y
CONFIG_PAYLOAD_EDK2=y
# CONFIG_EDK2_PRIORITIZE_INTERNAL is not set
CONFIG_EDK2_SD_MMC_TIMEOUT=3
# CONFIG_EDK2_SECURE_BOOT_SUPPORT is not set
CONFIG_EDK2_DISABLE_TPM=y
CONFIG_EDK2_USE_LAPIC_TIMER=y
CONFIG_COMPRESSED_PAYLOAD_ZSTD=y
# CONFIG_COMPRESS_SECONDARY_PAYLOAD is not set
```

## configs/x230_defconfig
```kconfig
CONFIG_COMPRESS_RAMSTAGE_ZSTD=y
CONFIG_VENDOR_LENOVO=y
CONFIG_LINEAR_FRAMEBUFFER_MAX_HEIGHT=768
CONFIG_LINEAR_FRAMEBUFFER_MAX_WIDTH=1366
CONFIG_ONBOARD_VGA_IS_PRIMARY=y
CONFIG_IFD_BIN_PATH="bins/x230/flashregion_0_flashdescriptor.bin"
CONFIG_ME_BIN_PATH="bins/x230/flashregion_2_intel_me.bin"
CONFIG_GBE_BIN_PATH="bins/x230/flashregion_3_gbe.bin"
CONFIG_HAVE_IFD_BIN=y
CONFIG_BOARD_LENOVO_X230=y
CONFIG_LINUX_COMMAND_LINE="console=tty"
CONFIG_POWER_STATE_ON_AFTER_FAILURE=y
CONFIG_USE_X86_64_SUPPORT=y
CONFIG_NATIVE_RAMINIT_IGNORE_MAX_MEM_FUSES=y
CONFIG_NATIVE_RAMINIT_IGNORE_XMP_MAX_DIMMS=y
CONFIG_HIDE_MEI_ON_ERROR=y
CONFIG_H8_FN_CTRL_SWAP=y
CONFIG_HAVE_ME_BIN=y
CONFIG_HAVE_GBE_BIN=y
CONFIG_GENERIC_LINEAR_FRAMEBUFFER=y
CONFIG_DRIVERS_PS2_KEYBOARD=y
# CONFIG_DRIVERS_MTK_WIFI is not set
# CONFIG_TPM1 is not set
CONFIG_PAYLOAD_LINUX=y
CONFIG_COMPRESSED_PAYLOAD_NONE=y
```

## t480s_defconfig
```kconfig
CONFIG_COMPILER_LLVM_CLANG=y
CONFIG_CCACHE=y
CONFIG_LTO=y
CONFIG_COMPRESS_RAMSTAGE_ZSTD=y
CONFIG_VENDOR_LENOVO=y
CONFIG_IFD_BIN_PATH="t480s/flashregion_0_flashdescriptor.bin"
CONFIG_ME_BIN_PATH="t480s/flashregion_2_intel_me.bin"
CONFIG_GBE_BIN_PATH="t480s/flashregion_3_gbe.bin"
CONFIG_INTEL_OC_MAILBOX_ENABLE_UNDERVOLTING=y
CONFIG_USE_LEGACY_8254_TIMER=y
CONFIG_HAVE_IFD_BIN=y
CONFIG_BOARD_LENOVO_T480S=y
CONFIG_H8_FN_CTRL_SWAP=y
CONFIG_HAVE_ME_BIN=y
CONFIG_HAVE_GBE_BIN=y
CONFIG_SMMSTORE=y
CONFIG_DRIVERS_PS2_KEYBOARD=y
# CONFIG_TPM2 is not set
CONFIG_PAYLOAD_LINUX=y
CONFIG_COMPRESSED_PAYLOAD_NONE=y
```
